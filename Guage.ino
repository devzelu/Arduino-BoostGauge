
//Arduino pro micro, .93" I2C OLED use pin 2 for SDA and 3 for SCL ***Look up i2c pins for your controller
#include <Wire.h>
#include <Adafruit_GFX.h>
#include <Adafruit_SSD1306.h>
#include <Adafruit_BMP085.h>

#define sensorPin A0
 
Adafruit_BMP085 bmp;
int OLED_RESET = 4;
Adafruit_SSD1306 display(OLED_RESET); //driver for the screen

const unsigned char audi_logo [] PROGMEM = {
  0x00, 0x00, 0x00, 0x00, 0x00, 0x00, 0x00, 0x00, 0x00, 0x00, 0x00, 0x00, 0x00, 0x00, 0x00, 0x00, 
  0x00, 0x00, 0x00, 0x7c, 0x00, 0x00, 0xfc, 0x00, 0x00, 0xf8, 0x00, 0x01, 0xf0, 0x00, 0x00, 0x00, 
  0x00, 0x00, 0x07, 0xff, 0xe0, 0x07, 0xff, 0xc0, 0x0f, 0xff, 0xc0, 0x1f, 0xff, 0x80, 0x00, 0x00, 
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  0x00, 0x00, 0x00, 0x00, 0x00, 0x00, 0x00, 0x00, 0x00, 0x00, 0x00, 0x00, 0x00, 0x00, 0x00, 0x00
};


// peak
int boostPeakReset = 10000; // time in milis to reset peak value
float boostPeak = 0.00;
float boostMax = 0.00;
unsigned long boostPeakTimer = 0;



boolean splashScreen = 1;

//Map sensor
int mapsen = 0; // Set MAP sensor input on Analog port 0
int NUM_SAMPLES= 300;  // number of samples
float sum = 0; // sum of samples taken
int sample_count = 0; // current sample number
float input_voltage = 5; //measured with multimeter

int lastBar=0;


void setup()
{
  Serial.begin(9600);
  bmp.begin(0x77);
  display.begin(0x3C); // 3.3V power supply
  display.clearDisplay(); // Clear the display and ram
  display.display();
}


void loop() // Start loop
{
  display.clearDisplay(); // Clear the display and ram
  if(splashScreen==1){
    Splash();
    delay(2000);
  }
  else{
  Boost();
  }
}

void Boost(){

  sum = 0;
  sample_count = 0;
  while (sample_count < NUM_SAMPLES) {
        sum += float(analogRead(mapsen));
        sample_count++;
        delay(0.5);
    } 
 float barometricPressure = bmp.readPressure();  //Return Pa
 float out_voltage = (sum / NUM_SAMPLES * input_voltage) / 1024;
 //float Pabs = out_voltage*3294.1176/input_voltage-63.5294; //absolute pressure in mbar
 //float Pabs = 270*(out_voltage/input_voltage)-2,5; // Map sensor 2.5Bara audi b7 1.8t 
 //y=-(2.5-54*out_voltage);
 float Pabs = -(2.5-54*out_voltage); // Return kPa
 Pabs = Pabs *1000; // Absolute Presure in Pa
 //float Pabs = 0.6588*out_voltage-0.0635;
 float boostBar = (Pabs-barometricPressure)*0.00001;
 //boostBar = round(boostBar*100)/100.0;
 if(boostBar>0)
 {

 display.fillRect(0, 0, boostBar*52, 4, WHITE);
 }

  if (boostPeak < boostBar && boostBar > 0.10) {
    boostPeak = boostBar;
    boostPeakTimer = millis();
    if (boostMax < boostPeak) {
      boostMax = boostPeak;
    }
  }
  else if (boostPeak > boostBar && (millis() - boostPeakTimer) > boostPeakReset) {
    boostPeak = 0.00;
  }


  display.setTextSize(1); //Display peak boost
  display.setCursor(97, 10);
  display.println(boostPeak); // 0.97 = 970mbar atmospheric pressure correction

 if (boostBar < -0.03) {
    display.setTextSize(1);
    display.setCursor(97, 20);
    display.println("VAC");
    display.setTextColor(WHITE);
    display.setCursor(0, 10);
    display.setTextSize(3);
    display.println(boostBar);
  }
 
  else if (boostBar > 0.03) {
    display.setTextSize(1);
    display.setCursor(97, 20);
    display.println("BOOST");
    display.setTextColor(WHITE);
    display.setTextSize(3);
    display.setCursor(0, 10);
    display.println("0"+String(boostBar));
  }
   else{
    display.setTextSize(1);
    display.setCursor(97, 20);
    display.println("IDLE");
    display.setTextColor(WHITE);
    display.setCursor(0, 10);
    display.setTextSize(3);
    display.println("00.00");
 }
  display.display();
  display.clearDisplay();
  Serial.println(boostBar);
}  

void Splash() {
display.drawBitmap(0, 0, audi_logo, 128, 64, WHITE);
  splashScreen = 0;
  display.display();
}
